## bsp/stm32/stm32f407vg-lckfb-skystar/board/ports/esp8266-01s/Kconfig
```kconfig
menu "ESP8266 Driver"

config BSP_USING_ESP8266
    bool "Enable onboard ESP8266-01S (AT Command, UART1)"
    default n
    select BSP_USING_UART
    select BSP_USING_UART1
    select RT_USING_AT
    select AT_USING_CLIENT
    select PKG_USING_AT_DEVICE
    select AT_DEVICE_USING_ESP8266
    select AT_DEVICE_ESP8266_SAMPLE
    select AT_DEVICE_ESP8266_SAMPLE_BSP_TAKEOVER

if BSP_USING_ESP8266

config ESP8266_SAMPLE_WIFI_SSID
    string "WiFi SSID"
    default "rtthread"

config ESP8266_SAMPLE_WIFI_PASSWORD
    string "WiFi password"
    default "12345678"

config ESP8266_SAMPLE_CLIENT_NAME
    string "AT client serial device name"
    default "uart1"

config ESP8266_SAMPLE_RECV_BUFF_LEN
    int "AT client receive buffer length"
    default 512
    range 256 4096

config BSP_ESP8266_USING_PIN_CONTROL
    bool "Enable EN/RST pin control"
    default n
    select BSP_USING_GPIO
    help
        ESP8266-01S EN and RST pins are internally pulled high by default.
        Enable this option if you need to control these pins via GPIO.

if BSP_ESP8266_USING_PIN_CONTROL

choice
    prompt "RST pin port"
    default BSP_ESP8266_RST_PORT_A

config BSP_ESP8266_RST_PORT_A
    bool "GPIOA"

config BSP_ESP8266_RST_PORT_B
    bool "GPIOB"

config BSP_ESP8266_RST_PORT_C
    bool "GPIOC"

config BSP_ESP8266_RST_PORT_D
    bool "GPIOD"

config BSP_ESP8266_RST_PORT_E
    bool "GPIOE"

config BSP_ESP8266_RST_PORT_F
    bool "GPIOF"

config BSP_ESP8266_RST_PORT_G
    bool "GPIOG"

config BSP_ESP8266_RST_PORT_H
    bool "GPIOH"
endchoice

config BSP_ESP8266_RST_PIN_NUM
    int "RST pin number (0-15)"
    default 6
    range 0 15

choice
    prompt "EN pin port"
    default BSP_ESP8266_EN_PORT_A

config BSP_ESP8266_EN_PORT_A
    bool "GPIOA"

config BSP_ESP8266_EN_PORT_B
    bool "GPIOB"

config BSP_ESP8266_EN_PORT_C
    bool "GPIOC"

config BSP_ESP8266_EN_PORT_D
    bool "GPIOD"

config BSP_ESP8266_EN_PORT_E
    bool "GPIOE"

config BSP_ESP8266_EN_PORT_F
    bool "GPIOF"

config BSP_ESP8266_EN_PORT_G
    bool "GPIOG"

config BSP_ESP8266_EN_PORT_H
    bool "GPIOH"
endchoice

config BSP_ESP8266_EN_PIN_NUM
    int "EN pin number (0-15)"
    default 7
    range 0 15

endif

comment "May adjust RT_SERIAL_RB_BUFSZ up to 512 if using the Serial V1 device driver"

endif

endmenu
```

## bsp/stm32/stm32f407vg-lckfb-skystar/board/ports/led/Kconfig
```kconfig
menu "LED Driver"

config BSP_USING_LED
    bool "Enable onboard LED"
    default n
    select BSP_USING_GPIO

if BSP_USING_LED

choice
    prompt "Default boot mode"
    default BSP_LED_BOOT_MODE_GPIO

    config BSP_LED_BOOT_MODE_GPIO
        bool "GPIO blink"

    config BSP_LED_BOOT_MODE_PWM
        bool "PWM breathe"

    config BSP_LED_BOOT_MODE_OFF
        bool "Off"
endchoice

config BSP_LED_BOOT_BLINK
    bool
    default y if BSP_LED_BOOT_MODE_GPIO

config BSP_LED_BOOT_BREATHE
    bool
    default y if BSP_LED_BOOT_MODE_PWM

config BSP_LED_BLINK_INTERVAL
    int "Blink interval (ms)"
    default 500
    range 50 5000

config BSP_LED_BREATHE_PERIOD
    int "Breathing cycle period (ms)"
    default 3000
    range 500 10000

config BSP_LED_SW_PWM_PERIOD
    int "Software PWM period (ms)"
    default 20
    range 5 50

endif

endmenu
```

## bsp/stm32/stm32f407vg-lckfb-skystar/board/ports/onenet/Kconfig
```kconfig
menu "Board Support Packages"

menuconfig BSP_USING_ONENET
    bool "OneNET: China Mobile OneNet cloud SDK (Local)"
    default n
    select PKG_USING_CJSON

if BSP_USING_ONENET

    config BSP_ONENET_USING_SAMPLE
        bool "Enable OneNET sample"
        default n

    choice
        prompt "OneNET protocol"
        default BSP_ONENET_USING_MQTT

        config BSP_ONENET_USING_MQTT
            bool "MQTT protocol"
            select PKG_USING_PAHOMQTT

        config BSP_ONENET_USING_HTTP
            bool "HTTP protocol"
            select PKG_USING_WEBCLIENT
    endchoice

    config BSP_ONENET_AUTO_INIT
        bool "Enable auto initialize on boot"
        default n
        depends on BSP_ONENET_USING_MQTT
        select BSP_USING_ESP8266
        help
            Auto connect to OneNET MQTT server on system startup.
            This requires ESP8266 network device to be enabled.

    config BSP_ONENET_NETDEV_NAME
        string "Network device name for auto connect"
        default "esp0"
        depends on BSP_ONENET_AUTO_INIT
        help
            Specify the network device name to check connection status before MQTT connect.
            The MQTT will auto connect when the network device is link up.
            Examples: esp0, e0, wlan0

    config BSP_ONENET_AUTO_RECONNECT
        bool "Enable auto reconnect when network disconnected"
        default y
        depends on BSP_ONENET_AUTO_INIT
        help
            Auto reconnect to OneNET MQTT server when network link up again

    choice
        prompt "Device type"
        default BSP_ONENET_DEVICE_DIRECT
        depends on BSP_ONENET_USING_MQTT

        config BSP_ONENET_DEVICE_DIRECT
            bool "Direct connection device"

        config BSP_ONENET_DEVICE_GATEWAY
            bool "Gateway device"
    endchoice

    menu "MQTT Topics Configuration"
        depends on BSP_ONENET_USING_MQTT

        config BSP_ONENET_USING_PROPERTY_POST
            bool "Enable property post reply topic"
            default y
            help
                Subscribe to property post reply topic: $sys/{pid}/{device-name}/thing/property/post/reply

        config BSP_ONENET_USING_PROPERTY_SET
            bool "Enable property set topic"
            default y
            help
                Subscribe to property set topic: $sys/{pid}/{device-name}/thing/property/set

        config BSP_ONENET_USING_PROPERTY_GET
            bool "Enable property get topic"
            default y
            help
                Subscribe to property get topic: $sys/{pid}/{device-name}/thing/property/get

        config BSP_ONENET_USING_PROPERTY_DESIRED_GET
            bool "Enable property desired get reply topic"
            default y
            help
                Subscribe to property desired get reply topic: $sys/{pid}/{device-name}/thing/property/desired/get/reply

        config BSP_ONENET_USING_PROPERTY_DESIRED_DELETE
            bool "Enable property desired delete reply topic"
            default y
            help
                Subscribe to property desired delete reply topic: $sys/{pid}/{device-name}/thing/property/desired/delete/reply

        config BSP_ONENET_USING_OTA
            bool "Enable OTA upgrade topic"
            default y
            help
                Subscribe to OTA inform topic: $sys/{pid}/{device-name}/ota/inform
    endmenu

    menu "Auto Reply Configuration"
        depends on BSP_ONENET_USING_MQTT

        config BSP_ONENET_AUTO_REPLY_SET
            bool "Enable auto reply for property set"
            default y
            depends on BSP_ONENET_USING_PROPERTY_SET
            help
                Auto reply to property set request with success response

        config BSP_ONENET_AUTO_REPLY_GET
            bool "Enable auto reply for property get"
            default y
            depends on BSP_ONENET_USING_PROPERTY_GET
            help
                Auto reply to property get request with current property values

        config BSP_ONENET_AUTO_REPLY_OTA
            bool "Enable auto reply for OTA inform"
            default y
            depends on BSP_ONENET_USING_OTA
            help
                Auto reply to OTA inform notification
    endmenu

    config BSP_ONENET_USING_AUTO_REGISTER
        bool "Enable OneNET automatic register device"
        default n
        depends on BSP_ONENET_USING_HTTP
        help
            Enable automatic registration device functions, don't need to register on the web page

    config BSP_ONENET_INFO_DEVID
        string "Device name"
        default "STM32F407VGT6_SKYSTAR"
        depends on !BSP_ONENET_USING_AUTO_REGISTER
        help
            Device name (not device ID number)

    config BSP_ONENET_INFO_PROID
        string "Product ID"
        default "OmZ40ZapAD"

    config BSP_ONENET_REGISTRATION_CODE
        string "Registration code"
        default "17eu2xb5k1GtbdY5"
        depends on BSP_ONENET_USING_AUTO_REGISTER
        help
            Product registration code

endif

endmenu
```

## bsp/stm32/stm32f407vg-lckfb-skystar/board/ports/sdcard/Kconfig
```kconfig
menu "SDCARD Driver"

config BSP_USING_SDCARD
    bool "Enable SDCARD (SDIO)"
    default n
    select BSP_USING_SDIO
    select RT_USING_DFS_ELMFAT

if BSP_USING_SDCARD

config BSP_SDCARD_AUTO_MOUNT
    bool "Auto mount SD card on startup"
    default y
    help
        Automatically mount SD card when detected on system startup.

if BSP_SDCARD_AUTO_MOUNT

config BSP_SDCARD_MOUNT_POINT
    string "SD card mount point"
    default "/sdcard"
    help
        The directory where the SD card will be mounted.
        Common choices: /sdcard, /mnt, /

config BSP_SDCARD_FORMAT_IF_FAIL
    bool "Format SD card if mount fails"
    default n
    help
        Automatically format the SD card if mounting fails.
        Warning: This will erase all data on the SD card.
        Use with caution!

config BSP_SDCARD_MOUNT_RETRY
    int "Mount retry count"
    default 3
    range 1 10
    help
        Number of retries when mounting fails.

endif

config BSP_SDCARD_HOT_PLUG
    bool "Enable hot plug detection"
    default y
    help
        Enable SD card hot plug detection thread.
        The SD card will be mounted when inserted and unmounted when removed.

if BSP_SDCARD_HOT_PLUG

choice
    prompt "SD card detect pin port"
    default BSP_SDCARD_DET_PORT_D

config BSP_SDCARD_DET_PORT_A
    bool "GPIOA"

config BSP_SDCARD_DET_PORT_B
    bool "GPIOB"

config BSP_SDCARD_DET_PORT_C
    bool "GPIOC"

config BSP_SDCARD_DET_PORT_D
    bool "GPIOD"

config BSP_SDCARD_DET_PORT_E
    bool "GPIOE"

config BSP_SDCARD_DET_PORT_F
    bool "GPIOF"

config BSP_SDCARD_DET_PORT_G
    bool "GPIOG"

config BSP_SDCARD_DET_PORT_H
    bool "GPIOH"
endchoice

config BSP_SDCARD_DET_PIN_NUM
    int "SD card detect pin number (0-15)"
    default 3
    range 0 15
    help
        The pin number for SD card detection.
        Default is PD3 (SD_CARD_DET_Pin from CubeMX config).

config BSP_SDCARD_DET_ACTIVE_LOW
    bool "Detect pin active low"
    default y
    help
        SD card is detected when the detect pin is LOW.
        If disabled, SD card is detected when pin is HIGH.

config BSP_SDCARD_MOUNT_THREAD_STACK
    int "Mount thread stack size"
    default 2048
    range 1024 4096

config BSP_SDCARD_MOUNT_THREAD_PRIORITY
    int "Mount thread priority"
    default 8
    range 1 32

endif

endif

endmenu
```

## bsp/stm32/stm32f407vg-lckfb-skystar/board/ports/usb/Kconfig
```kconfig
menu "CherryUSB Driver"

config BSP_CHERRYUSB_DEVICE_DEFAULT_DWC2_ST
    bool
    default y if BSP_USING_USB_CDC || BSP_USING_USB_MSC || BSP_USING_USB_CDC_MSC || BSP_USING_USB_HID || BSP_USING_USB_CDC_HID || BSP_USING_USB_MSC_HID

choice
    prompt "USB Device Mode"
    default BSP_USB_DEVICE_NONE

config BSP_USB_DEVICE_NONE
    bool "Disabled"

config BSP_USING_USB_CDC
    bool "CDC only (Virtual Serial Port)"
    depends on !BSP_USING_USBD
    select RT_USING_CHERRYUSB
    select RT_CHERRYUSB_DEVICE
    select RT_CHERRYUSB_DEVICE_CDC_ACM
    help
        Enable CherryUSB CDC ACM device mode only. A virtual serial port
        (COM) will be available for communication.

config BSP_USING_USB_HID
    bool "HID only (Custom HID Device)"
    depends on !BSP_USING_USBD
    select RT_USING_CHERRYUSB
    select RT_CHERRYUSB_DEVICE
    select RT_CHERRYUSB_DEVICE_HID
    help
        Enable CherryUSB HID device mode only. A custom HID device with
        IN+OUT interrupt endpoints will be available for generic data
        transfer. Suitable for custom communication protocols.

config BSP_USING_USB_MSC
    bool "MSC only (SD card as U-disk)"
    depends on !BSP_USING_USBD
    select RT_USING_CHERRYUSB
    select RT_CHERRYUSB_DEVICE
    select RT_CHERRYUSB_DEVICE_MSC
    select BSP_USING_SDIO
    help
        Enable CherryUSB MSC device mode only. The SD card will appear
        as a removable disk on the connected computer.

config BSP_USING_USB_CDC_MSC
    bool "CDC+MSC (Virtual Serial Port + SD card as U-disk)"
    depends on !BSP_USING_USBD
    select RT_USING_CHERRYUSB
    select RT_CHERRYUSB_DEVICE
    select RT_CHERRYUSB_DEVICE_CDC_ACM
    select RT_CHERRYUSB_DEVICE_MSC
    select BSP_USING_SDIO
    help
        Enable CherryUSB CDC+MSC composite device. The SD card will appear
        as a removable disk, and a virtual serial port (COM) will also be
        available for communication.

config BSP_USING_USB_CDC_HID
    bool "CDC+HID (Virtual Serial Port + Custom HID)"
    depends on !BSP_USING_USBD
    select RT_USING_CHERRYUSB
    select RT_CHERRYUSB_DEVICE
    select RT_CHERRYUSB_DEVICE_CDC_ACM
    select RT_CHERRYUSB_DEVICE_HID
    help
        Enable CherryUSB CDC+HID composite device. A virtual serial port
        (COM) and a custom HID device will be available simultaneously.
        The HID device can be used for custom data exchange with the host.

config BSP_USING_USB_MSC_HID
    bool "MSC+HID (SD card as U-disk + Custom HID)"
    depends on !BSP_USING_USBD
    select RT_USING_CHERRYUSB
    select RT_CHERRYUSB_DEVICE
    select RT_CHERRYUSB_DEVICE_MSC
    select RT_CHERRYUSB_DEVICE_HID
    select BSP_USING_SDIO
    help
        Enable CherryUSB MSC+HID composite device. The SD card will appear
        as a removable disk, and a custom HID device will also be available
        for custom data exchange with the host.

endchoice

if BSP_USING_USB_MSC || BSP_USING_USB_CDC_MSC || BSP_USING_USB_MSC_HID

config BSP_USB_MSC_BLOCK_DEV_NAME
    string "Block device name for USB MSC"
    default "sd0"
    help
        The RT-Thread block device name to expose via USB MSC.
        Default is "sd0" which corresponds to the SD card via SDIO.

config BSP_USB_MSC_READ_ONLY
    bool "Mount as read-only U-disk"
    default n
    help
        If enabled, the USB MSC device will be read-only on the host PC side.
        This prevents accidental data corruption from the host while the
        SD card may also be mounted locally.

endif

endmenu
```
